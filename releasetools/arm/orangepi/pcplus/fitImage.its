## releasetools/arm/orangepi/pcplus/fitImage.its
```
/dts-v1/;

/ {
	description = "Minix fitImage";
	#address-cells = <1>;

	images {

		  kernel {
             description = "Minix kernel";
             data = /incbin/("kernel.bin");
             type = "kernel";
             arch = "arm";
             compression = "none";
             os = "linux";
             load = <0x42000000>;
             entry = <0x42000000>;
             			hash {
             				algo = "crc32";
                };
          };

		   fdt {
    			description = "Device Tree";
    			data = /incbin/("devices.dtb"); // Include your DTB file
    			type = "flat_dt";
    			arch = "arm";
    			compression = "none";
    			hash {
    				algo = "crc32";
    			};

          };

		  ds {
        			description = "ds";
        			data = /incbin/("ds");
        			type = "loadable";
        			arch = "arm";
        			compression = "none";
                    os = "linux";
                    load = <0x43000000>;
                    entry = <0x43000000>;
        			hash {
        				algo = "crc32";
        			};

          };

          rs {
                			description = "rs";
                			data = /incbin/("rs");
                			type = "loadable";
                			arch = "arm";
                			compression = "none";
                            os = "linux";
                            load = <0x43800000>;
                            entry = <0x43800000>;
                			hash {
                				algo = "crc32";
                			};

          };

           pm {
                 			description = "pm";
                 			data = /incbin/("pm");
                 			type = "loadable";
                 			arch = "arm";
                 			compression = "none";
                             os = "linux";
                             load = <0x44000000>;
                             entry = <0x44000000>;
                 			hash {
                 				algo = "crc32";
                 			};

           };
            sched {
                  			description = "sched";
                  			data = /incbin/("sched");
                  			type = "loadable";
                  			arch = "arm";
                  			compression = "none";
                              os = "linux";
                              load = <0x44800000>;
                              entry = <0x44800000>;
                  			hash {
                  				algo = "crc32";
                  			};

           };


            vfs {
                            			description = "vfs";
                            			data = /incbin/("vfs");
                            			type = "loadable";
                            			arch = "arm";
                            			compression = "none";
                                        os = "linux";
                                        load = <0x45000000>;
                                        entry = <0x45000000>;
                            			hash {
                            				algo = "crc32";
                            			};

            };

            memory {
                    			description = "memory";
                    			data = /incbin/("memory");
                    			type = "loadable";
                    			arch = "arm";
                    			compression = "none";
                                os = "linux";
                                load = <0x45800000>;
                                entry = <0x45800000>;
                    			hash {
                    				algo = "crc32";
                    			};

            };

            tty {
                    			description = "tty";
                    			data = /incbin/("tty");
                    			type = "loadable";
                    			arch = "arm";
                    			compression = "none";
                                os = "linux";
                                load = <0x46000000>;
                                entry = <0x46000000>;
                    			hash {
                    				algo = "crc32";
                    			};

            };

            mib {
                    			description = "mib";
                    			data = /incbin/("mib");
                    			type = "loadable";
                    			arch = "arm";
                    			compression = "none";
                                os = "linux";
                                load = <0x46800000>;
                                entry = <0x46800000>;
                    			hash {
                    				algo = "crc32";
                    			};

            };

            vm {
                    			description = "vm";
                    			data = /incbin/("vm");
                    			type = "loadable";
                    			arch = "arm";
                    			compression = "none";
                                os = "linux";
                                load = <0x47000000>;
                                entry = <0x47000000>;
                    			hash {
                    				algo = "crc32";
                    			};

            };

           pfs {
                   			description = "pfs";
                   			data = /incbin/("pfs");
                   			type = "loadable";
                   			arch = "arm";
                   			compression = "none";
                               os = "linux";
                               load = <0x47800000>;
                               entry = <0x47800000>;
                   			hash {
                   				algo = "crc32";
                   			};

           };

           mfs {
                   			description = "mfs";
                   			data = /incbin/("mfs");
                   			type = "loadable";
                   			arch = "arm";
                   			compression = "none";
                               os = "linux";
                               load = <0x48000000>;
                               entry = <0x48000000>;
                   			hash {
                   				algo = "crc32";
                   			};

           };


		  init {
        			description = "init";
        			data = /incbin/("init");
        			type = "loadable";
        			arch = "arm";
        			compression = "none";
                    os = "linux";
                    load = <0x48800000>;
                    entry = <0x48800000>;
        			hash {
        				algo = "crc32";
        			};

          };


	};

	configurations {
		default = "config";
		config {
			description = "Default config";
			kernel = "kernel";
			fdt = "fdt";
			loadables= "ds", "init", "memory", "mfs", "mib", "pfs", "pm", "rs", "sched", "tty", "vfs", "vm";
		};
	};
};
```
